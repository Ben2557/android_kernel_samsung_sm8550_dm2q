## custom_defconfigs/custom_defconfig
```kconfig
# Disable Samsung anti-root protection
CONFIG_UH=n
CONFIG_RKP=n
CONFIG_KDP=n 
CONFIG_SECURITY_DEFEX=n
CONFIG_PROCA=n
CONFIG_FIVE=n

# Disable Werror
CONFIG_WERROR=n

# Add LOCALVERSION
CONFIG_LOCALVERSION="-ROOT-LKM-S916BXXS3AWIF"
CONFIG_LOCALVERSION_AUTO=n

# Kernel modules
CONFIG_MODULES=y

# KernelSU
# CONFIG_KSU is not set
```
